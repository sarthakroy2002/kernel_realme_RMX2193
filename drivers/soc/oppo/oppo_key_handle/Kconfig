## drivers/soc/oppo/oppo_key_handle/Kconfig
```kconfig
config OPPO_FORCE_DUMP
	bool "config oppo force dump"
	help
		define force dump functions

config OPPO_FORCE_TPLG
	bool "config oppo force tp log"
	help
		define force tp log functions
```
